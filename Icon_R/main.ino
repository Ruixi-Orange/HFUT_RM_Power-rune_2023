/******************头文件定义************************/
#include <FastLED.h> //加载灯带头文件
/******************头文件定义************************/
#include <Arduino.h>

/******************宏定义***********************/

const uint8_t favicon_map[] = {
    /*Pixel format: Red: 3 bit, Green: 3 bit, Blue: 2 bit*/
  0xff, 0xff, 0xdb, 0xdb, 0xdb, 0xdb, 0xdb, 0xdb, 0xdb, 0xdb, 0xdb, 0xdb, 0xdb, 0xff, 0xff, 0xff, 
  0xff, 0xff, 0x49, 0x00, 0x00, 0x00, 0x00, 0x00, 0x00, 0x00, 0x00, 0x00, 0x00, 0x49, 0xff, 0xff, 
  0xff, 0xff, 0xdb, 0x24, 0x00, 0x00, 0x00, 0x49, 0x49, 0x49, 0x49, 0x49, 0x00, 0x00, 0x6d, 0xff, 
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  0xff, 0xff, 0xff, 0xff, 0xff, 0xff, 0xff, 0xff, 0xff, 0xff, 0xff, 0xff, 0xff, 0xff, 0xff, 0xff, 
};

#define NUM_LEDS 16 * 16 // 灯珠数量
#define LED_TYPE WS2812  // 灯带型号
#define COLOR_ORDER GRB  // 输入颜色的顺序 根据手册决定
CRGB leds[NUM_LEDS];     // 构建灯珠对象
#define DATA_PIN 5

void setup()
{
  FastLED.addLeds<LED_TYPE, DATA_PIN, COLOR_ORDER>(leds, NUM_LEDS).setCorrection(TypicalLEDStrip); // 初始化灯带模板 无需变动复制粘贴即可
  FastLED.setBrightness(200);                                                                      // 初始化亮度

#if 1


  for (uint8_t i = 0; i < 16; i++)
  {
      for (uint8_t j = 0; j < 16; j++)
      {
        if(i % 2)
        leds[i * 16 + j] = CHSV(0, 255, 255 - favicon_map[i * 16 + j]);
        else
        leds[(i+1) * 16 - j] = CHSV(0, 255, 255 - favicon_map[i * 16 + j]);
      }
    
    
  }
  FastLED.show();
#endif 


}


void loop(){


}